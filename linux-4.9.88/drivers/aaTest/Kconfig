## linux-4.9.88/drivers/aaTest/Kconfig
```kconfig
menu "aaTest Drivers"

config AATEST_HELLO
	tristate "Simple Hello World driver"
	default m
	help
	  This is a simple Hello World driver for testing.

endmenu
```
